## main/Kconfig.projbuild
```kconfig
menu "HTTPS Server Login/password"

    config SERVER_USERNAME
        string "Server Username"
        default "admin"
        help
            Username to login.

    config SERVER_PASSWORD
        string "Server Password"
        default "admin"
        help
            Server password to login into server.
        
endmenu

menu "Sensors GPIO"

    config GPIO_HALL_SENSOR
        int "Hall sensor digital input"
        range 1 39
        default 23
        help
            44E 402 Digitial hall sensor input.

    config GPIO_TEMPERATURE
        int "LM35 analog input"
        range 1 39
        default 36
        help
            LM35 Centigrede sensor input.

    config GPIO_HUMIDITY
        int "AM2302 digital humidity and temperature sensor input"
        range 1 39
        default 22
        help
            AM2302 digital humidity and temperature sensor input.

    config GPIO_SOLAR_INCIDENCE
        int "Photovoltaic plate"
        range 1 39
        default 35
        help
            Photovoltaic plate sensor input.
        
endmenu

menu "Conexao Wifi"
    config WIFI_SSID
        string "Wifi SSID"
        default "galito"
        help
            Wifi ssid to connect.

    config WIFI_PASSWORD
        string "Wifi Password"
        default "132128ccj"
        help
            Wifi password to connect.
endmenu
```
